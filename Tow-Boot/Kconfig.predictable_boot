## Tow-Boot/Kconfig.predictable_boot
```kconfig
choice
	prompt "Tow-Boot predictable boot"
	default TOW_BOOT_PREDICTABLE_BOOT_PREFER_INTERNAL
	help
		Selects which predictable boot order strategy is used.
		 - Internal prefers eMMC, NVMe, SCSI, SD, then USB
		 - External prefers the inverse order
		Both order will keep network boot and SF booting at the end of the list.

config TOW_BOOT_PREDICTABLE_BOOT_PREFER_INTERNAL
	bool "Prefer the more internal storage first"

config TOW_BOOT_PREDICTABLE_BOOT_PREFER_EXTERNAL
	bool "Prefer the more external storage first"

endchoice

config TOW_BOOT_NETWORK_BOOT
	bool "Include network boot in the boot order"
	default y
	help
		Puts the PXE and DHCP targets at the end of the predictable boot
		order. Turning this off leaves both commands in place but keeps
		them out of the automatic sequence, where a board that has no
		network boot to do spends about a minute timing out on TFTP
		before it gives up and falls into the menu.
```

## configs/pinephone_defconfig
```kconfig
CONFIG_ARM=y
CONFIG_ARCH_SUNXI=y
CONFIG_DEFAULT_DEVICE_TREE="sun50i-a64-pinephone-1.2"
CONFIG_DRAM_CLK=552
CONFIG_SPL_DRIVERS_MISC=y
CONFIG_SPL=y
CONFIG_PINEPHONE_LEDS=y
CONFIG_MACH_SUN50I=y
CONFIG_SUNXI_DRAM_LPDDR3_STOCK=y
CONFIG_DRAM_ZQ=3881949
CONFIG_MMC_SUNXI_SLOT_EXTRA=2
CONFIG_VIDEO_SUNXI_MIPI_DSI=y
CONFIG_SUNXI_VIDCONSOLE_FIRST=y
CONFIG_PINEPHONE_DT_SELECTION=y
# CONFIG_SYS_MALLOC_CLEAR_ON_INIT is not set
CONFIG_CMD_BMP=y
CONFIG_CMD_PSTORE=y
CONFIG_CMD_PSTORE_MEM_ADDR=0x61000000
CONFIG_CMD_PMIC=y
CONFIG_CMD_REGULATOR=y
CONFIG_OF_LIST="sun50i-a64-pinephone-1.1 sun50i-a64-pinephone-1.2"
CONFIG_BUTTON=y
CONFIG_BUTTON_SUN4I_LRADC=y
CONFIG_BUTTON_AXP_PEK=y
CONFIG_SYS_I2C_SUN8I_RSB=y
CONFIG_SYS_I2C_MVTWSI=y
CONFIG_BUTTON_KEYBOARD=y
CONFIG_PINEPHONE_KEYBOARD=y
CONFIG_LED_STATUS=y
CONFIG_LED_STATUS_GPIO=y
CONFIG_LED_STATUS0=y
CONFIG_LED_STATUS_BIT=114
CONFIG_LED_STATUS_STATE=2
CONFIG_DM_PMIC=y
CONFIG_PMIC_AXP=y
CONFIG_REGULATOR_AXP=y
CONFIG_DM_PWM=y
CONFIG_PWM_SUNXI=y
# CONFIG_VIDEO_FONT_8X16 is not set
CONFIG_VIDEO_FONT_16X32=y
CONFIG_VIDEO_PANEL_XINGBANGDA_XBD599=y
CONFIG_BMP_16BPP=y
CONFIG_BMP_24BPP=y
CONFIG_BMP_32BPP=y
CONFIG_USB_MUSB_GADGET=y
CONFIG_USB_GADGET_DOWNLOAD=y
CONFIG_CMD_USB_MASS_STORAGE=y
CONFIG_USB_GADGET_MANUFACTURER="Pine64"
CONFIG_USB_GADGET_PRODUCT_NUM=0x1010
CONFIG_BOOTCOMMAND="if button 'Volume Up'; then echo Entering USB mass storage mode; ums 0 mmc 2; fi; run distro_bootcmd"
```
